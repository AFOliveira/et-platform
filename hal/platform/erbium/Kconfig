## hal/platform/erbium/Kconfig
```kconfig
# Copyright (c) 2026 AIFoundry
# SPDX-License-Identifier: Apache-2.0

config ZEPHYR_HAL_AIFOUNDRY_MODULE
	bool

config HAS_AIFOUNDRY_HAL
	bool
	help
	  Set when the AIFoundry HAL module is available.
```
